/*
 * OLED SSD1306 软件 I2C 驱动 (PA11=SDA, PA12=SCL)
 * 纯 CMSIS 寄存器操作，零 HAL 依赖
 */

#include "drv_oled.h"
#include "stm32f1xx.h"
#include <string.h>

/* ===================== 显示缓冲区 ===================== */
static uint8_t oled_buf[OLED_WIDTH * OLED_PAGES];

/* ===================== 6x12 字体库 ===================== */
static const uint8_t font_6x12[][12] = {
    {0x00,0x00,0x00,0x00,0x00,0x00,0x00,0x00,0x00,0x00,0x00,0x00},
    {0x00,0x00,0x00,0x5F,0x00,0x00,0x00,0x00,0x00,0x00,0x00,0x00},
    {0x00,0x00,0x07,0x00,0x07,0x00,0x00,0x00,0x00,0x00,0x00,0x00},
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    {0x00,0x02,0x01,0x02,0x04,0x02,0x00,0x00,0x00,0x00,0x00,0x00},
};

/* ===================== GPIO 底层操作 (CMSIS 寄存器) ===================== */
#define SCL_PIN  12  /* PA12 */
#define SDA_PIN  11  /* PA11 */

static inline void scl_high(void) { GPIOA->BSRR = (1U << SCL_PIN); }
static inline void scl_low(void)  { GPIOA->BRR  = (1U << SCL_PIN); }
static inline void sda_high(void) { GPIOA->BSRR = (1U << SDA_PIN); }
static inline void sda_low(void)  { GPIOA->BRR  = (1U << SDA_PIN); }

static inline void i2c_delay(void)
{
    volatile uint8_t i = 5;
    while (i--);
}

void oled_gpio_init(void)
{
    /* 使能 GPIOA 时钟 */
    RCC->APB2ENR |= RCC_APB2ENR_IOPAEN;

    /* PA11(SDA) 和 PA12(SCL): 推挽输出 50MHz
     * CRL: PA0-PA7,  CRH: PA8-PA15
     * PA11 -> CRH[15:12], PA12 -> CRH[19:16]
     * MODE=0b11 (50MHz), CNF=0b00 (推挽输出)
     */
    GPIOA->CRH &= ~((0xFU << 12) | (0xFU << 16));  /* 清除 PA11, PA12 配置 */
    GPIOA->CRH |=  ((0x3U << 12) | (0x3U << 16));  /* MODE=11, CNF=00 */

    /* 初始状态: SCL=HIGH, SDA=HIGH */
    scl_high();
    sda_high();
}

/* ===================== 软件 I2C 协议 ===================== */

void oled_i2c_start(void)
{
    sda_high();
    scl_high();
    i2c_delay();
    sda_low();
    i2c_delay();
    scl_low();
    i2c_delay();
}

void oled_i2c_stop(void)
{
    sda_low();
    scl_high();
    i2c_delay();
    sda_high();
    i2c_delay();
}

void oled_i2c_ack(void)
{
    scl_low();
    sda_high();
    i2c_delay();
    scl_high();
    i2c_delay();
    scl_low();
    i2c_delay();
}

void oled_i2c_send_byte(uint8_t data)
{
    uint8_t i;
    for (i = 0; i < 8; i++)
    {
        scl_low();
        if (data & 0x80)
            sda_high();
        else
            sda_low();
        data <<= 1;
        i2c_delay();
        scl_high();
        i2c_delay();
    }
    scl_low();
    oled_i2c_ack();
}

/* ===================== OLED 命令/数据 ===================== */

void oled_write_cmd(uint8_t cmd)
{
    oled_i2c_start();
    oled_i2c_send_byte(OLED_I2C_ADDR);
    oled_i2c_send_byte(0x00);
    oled_i2c_send_byte(cmd);
    oled_i2c_stop();
}

void oled_write_data(uint8_t data)
{
    oled_i2c_start();
    oled_i2c_send_byte(OLED_I2C_ADDR);
    oled_i2c_send_byte(0x40);
    oled_i2c_send_byte(data);
    oled_i2c_stop();
}

/* ===================== OLED 驱动初始化 ===================== */

void oled_init(void)
{
    oled_gpio_init();

    oled_write_cmd(0xAE);
    oled_write_cmd(0xD5);
    oled_write_cmd(0x80);
    oled_write_cmd(0xA8);
    oled_write_cmd(0x3F);
    oled_write_cmd(0xD3);
    oled_write_cmd(0x00);
    oled_write_cmd(0x40);
    oled_write_cmd(0x8D);
    oled_write_cmd(0x14);
    oled_write_cmd(0x20);
    oled_write_cmd(0x02);
    oled_write_cmd(0xA1);
    oled_write_cmd(0xC8);
    oled_write_cmd(0xDA);
    oled_write_cmd(0x12);
    oled_write_cmd(0x81);
    oled_write_cmd(0xCF);
    oled_write_cmd(0xD9);
    oled_write_cmd(0xF1);
    oled_write_cmd(0xDB);
    oled_write_cmd(0x40);
    oled_write_cmd(0xA4);
    oled_write_cmd(0xA6);
    oled_write_cmd(0xAF);

    oled_clear();
}

/* ===================== 显示控制 ===================== */

void oled_clear(void)
{
    memset(oled_buf, 0x00, sizeof(oled_buf));
    oled_refresh();
}

void oled_fill(uint8_t pattern)
{
    memset(oled_buf, pattern, sizeof(oled_buf));
    oled_refresh();
}

void oled_set_pos(uint8_t x, uint8_t page)
{
    oled_write_cmd(0xB0 + page);
    oled_write_cmd(0x00 + (x & 0x0F));
    oled_write_cmd(0x10 + ((x >> 4) & 0x0F));
}

void oled_display_on(void)
{
    oled_write_cmd(0x8D);
    oled_write_cmd(0x14);
    oled_write_cmd(0xAF);
}

void oled_display_off(void)
{
    oled_write_cmd(0xAE);
    oled_write_cmd(0x8D);
    oled_write_cmd(0x10);
}

/* ===================== 缓冲区刷新 ===================== */

void oled_refresh(void)
{
    uint8_t page, col;
    for (page = 0; page < OLED_PAGES; page++)
    {
        oled_set_pos(0, page);
        for (col = 0; col < OLED_WIDTH; col++)
        {
            oled_write_data(oled_buf[page * OLED_WIDTH + col]);
        }
    }
}

/* ===================== 基本绘图 ===================== */

void oled_draw_pixel(uint8_t x, uint8_t y, uint8_t on)
{
    if (x >= OLED_WIDTH || y >= OLED_HEIGHT) return;
    if (on)
        oled_buf[(y / 8) * OLED_WIDTH + x] |= (1 << (y % 8));
    else
        oled_buf[(y / 8) * OLED_WIDTH + x] &= ~(1 << (y % 8));
}

void oled_draw_char(uint8_t x, uint8_t page, char ch)
{
    uint8_t i;
    if (ch < ' ' || ch > '~') return;
    if (x > OLED_WIDTH - 6) return;

    for (i = 0; i < 6; i++)
        oled_buf[page * OLED_WIDTH + x + i] = font_6x12[ch - ' '][i];

    if (page + 1 < OLED_PAGES)
        for (i = 0; i < 6; i++)
            oled_buf[(page + 1) * OLED_WIDTH + x + i] = font_6x12[ch - ' '][i + 6];
}

/*
 * 绘制 ASCII 字符，支持 Y 方向像素偏移
 * y_offset: 向下偏移像素数 (0~7)
 * 用于混合行中对齐 16x16 汉字基线 (汉字像素从第2行开始)
 */
void oled_draw_char_offset(uint8_t x, uint8_t page, char ch, uint8_t y_offset)
{
    uint8_t i;
    if (ch < ' ' || ch > '~') return;
    if (x > OLED_WIDTH - 6) return;
    if (y_offset >= 8) return;
    if (y_offset == 0) {
        oled_draw_char(x, page, ch);
        return;
    }

    /* 将 12px 字体下移 y_offset 像素 */
    for (i = 0; i < 6; i++) {
        uint8_t lo = font_6x12[ch - ' '][i];
        uint8_t hi = font_6x12[ch - ' '][i + 6];
        /* 合并上下两部分，下移 y_offset 位 */
        uint16_t combined = ((uint16_t)hi << 8) | lo;
        combined <<= y_offset;
        if (page < OLED_PAGES)
            oled_buf[page * OLED_WIDTH + x + i] |= (uint8_t)(combined & 0xFF);
        if (page + 1 < OLED_PAGES)
            oled_buf[(page + 1) * OLED_WIDTH + x + i] |= (uint8_t)((combined >> 8) & 0xFF);
    }
}

void oled_draw_string(uint8_t x, uint8_t page, const char *str)
{
    uint8_t cx = x;
    while (*str)
    {
        if (cx > OLED_WIDTH - 6) break;
        oled_draw_char(cx, page, *str);
        cx += 6;
        str++;
    }
}

void oled_draw_number(uint8_t x, uint8_t page, int32_t num)
{
    char buf[12];
    int i = 0;
    int32_t n;

    if (num < 0)
    {
        oled_draw_char(x, page, '-');
        x += 6;
        num = -num;
    }
    if (num == 0)
    {
        oled_draw_char(x, page, '0');
        return;
    }
    n = num;
    while (n > 0 && i < 10)
    {
        buf[i++] = '0' + (n % 10);
        n /= 10;
    }
    while (--i >= 0)
    {
        oled_draw_char(x, page, buf[i]);
        x += 6;
        if (x > OLED_WIDTH - 6) break;
    }
}

void oled_draw_float(uint8_t x, uint8_t page, float num, uint8_t decimal)
{
    int32_t ipart;
    int32_t fpart;
    uint8_t i;
    int32_t mul = 1;

    if (num < 0)
    {
        oled_draw_char(x, page, '-');
        x += 6;
        num = -num;
    }

    for (i = 0; i < decimal; i++) mul *= 10;

    ipart = (int32_t)num;
    fpart = (int32_t)((num - (float)ipart) * (float)mul + 0.5f);
    if (fpart >= mul) { ipart++; fpart = 0; }

    oled_draw_number(x, page, ipart);
    /* 计算 ipart 占用的字符宽度 */
    {
        int32_t tmp = ipart < 0 ? -ipart : ipart;
        uint8_t w = 0;
        if (tmp == 0) w = 1;
        while (tmp > 0) { w++; tmp /= 10; }
        x += w * 6;
    }
    oled_draw_char(x, page, '.');
    x += 6;

    /* 补零输出小数部分 */
    {
        int32_t div = mul / 10;
        while (div > 0)
        {
            oled_draw_char(x, page, '0' + (fpart / div) % 10);
            x += 6;
            div /= 10;
            if (x > OLED_WIDTH - 6) break;
        }
    }
}

/* ===================== 16x16 汉字绘制 ===================== */

#include "font_lib.h"

/*
 * 在 OLED 缓冲区中绘制一个 16x16 汉字
 * x:    像素列 (0~112)
 * page: 起始页 (0~6, 需要连续2页空间)
 *
 * 字体数据格式: 横向扫描, 字节高位在前
 *   每行 2 字节 (hi_byte, lo_byte), 共 16 行
 * OLED 缓冲区: 垂直字节, 每页 8 行
 *
 * 转换: 字体行 r → OLED 像素行 (page*8 + r%8)
 *       字体第 r 行的数据 → oled_buf 的 page+(r/8) 页
 */
void oled_draw_chinese_char(uint8_t x, uint8_t page, uint16_t unicode)
{
    const unsigned char *bmp = font_get_bitmap(unicode);
    uint16_t idx;
    if (!bmp) return;
    if (x > OLED_WIDTH - 16) return;
    if (page > OLED_PAGES - 2) return;

    for (int row = 0; row < 16; row++) {
        uint8_t hi = bmp[row * 2];
        uint8_t lo = bmp[row * 2 + 1];
        uint8_t target_page = page + (row / 8);
        uint8_t bit_mask = (1 << (row % 8));

        for (int col = 0; col < 8; col++) {
            idx = target_page * OLED_WIDTH + x + col;
            if (idx < sizeof(oled_buf) && (hi & (0x80 >> col))) {
                oled_buf[idx] |= bit_mask;
            }
        }
        for (int col = 0; col < 8; col++) {
            idx = target_page * OLED_WIDTH + x + 8 + col;
            if (idx < sizeof(oled_buf) && (lo & (0x80 >> col))) {
                oled_buf[idx] |= bit_mask;
            }
        }
    }
}

/* UTF-8 解码辅助 */
static uint32_t _oled_utf8_decode(const char *str, int *bytes)
{
    unsigned char c = (unsigned char)str[0];
    if (c == 0) { *bytes = 0; return 0; }
    if (c < 0x80) { *bytes = 1; return c; }
    if ((c & 0xE0) == 0xC0) {
        *bytes = 2;
        return ((uint32_t)(c & 0x1F) << 6) | ((uint32_t)(unsigned char)str[1] & 0x3F);
    }
    if ((c & 0xF0) == 0xE0) {
        *bytes = 3;
        return ((uint32_t)(c & 0x0F) << 12) |
               ((uint32_t)(unsigned char)str[1] & 0x3F) << 6 |
               ((uint32_t)(unsigned char)str[2] & 0x3F);
    }
    *bytes = 1;
    return 0xFFFD;
}

void oled_draw_chinese_string(uint8_t x, uint8_t page, const char *utf8_str)
{
    if (!utf8_str) return;
    uint8_t cx = x;
    while (*utf8_str) {
        int bytes = 0;
        uint32_t cp = _oled_utf8_decode(utf8_str, &bytes);
        if (cp == 0) break;
        if (cp <= 0xFFFF && font_char_exists((uint16_t)cp)) {
            if (cx > OLED_WIDTH - 16) break;
            oled_draw_chinese_char(cx, page, (uint16_t)cp);
            cx += 16;
        }
        utf8_str += bytes;
    }
}

void oled_draw_mix_line(uint8_t page, const char *chinese_label, const char *ascii_text)
{
    if (page > OLED_PAGES - 2) return;

    /* 清除该两页区域 */
    uint8_t p;
    for (p = page; p < page + 2 && p < OLED_PAGES; p++) {
        uint16_t i;
        for (i = 0; i < OLED_WIDTH; i++) {
            oled_buf[p * OLED_WIDTH + i] = 0;
        }
    }

    /* 左侧: 汉字标签 */
    uint8_t cx = 0;
    if (chinese_label) {
        const char *s = chinese_label;
        while (*s) {
            int bytes = 0;
            uint32_t cp = _oled_utf8_decode(s, &bytes);
            if (cp == 0) break;
            if (cp <= 0xFFFF && font_char_exists((uint16_t)cp)) {
                if (cx > OLED_WIDTH - 40) break; /* 为右侧 ASCII 留空间 */
                oled_draw_chinese_char(cx, page, (uint16_t)cp);
                cx += 16;
            }
            s += bytes;
        }
    }

    /* 右侧: ASCII 文本 (下移 2px 对齐汉字基线) */
    if (ascii_text) {
        uint8_t ax = cx + 2;
        const char *s = ascii_text;
        while (*s) {
            if (ax > OLED_WIDTH - 6) break;
            oled_draw_char_offset(ax, page, *s, 2);
            ax += 6;
            s++;
        }
    }
}
